## boards/arm/com_f103c8/Kconfig.board
```kconfig
config BOARD_COM_H723ZG
	bool "STM32 Minimum Development Board"
	depends on SOC_STM32F103X8
```

## boards/arm/com_f103c8/Kconfig.defconfig
```kconfig
if BOARD_COM_F103C8

config BOARD
	default "com_f103c8"

endif # BOARD_COM_F103C8
```
